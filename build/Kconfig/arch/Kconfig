## build/Kconfig/arch/Kconfig
```kconfig
# Load Zephyr Arch Kconfig descriptions.
osource "D:/SDU/bachelor_project/zephyr-workspace/zephyr/arch/rx/Kconfig"
osource "D:/SDU/bachelor_project/zephyr-workspace/zephyr/arch/x86/Kconfig"
osource "D:/SDU/bachelor_project/zephyr-workspace/zephyr/arch/xtensa/Kconfig"
osource "D:/SDU/bachelor_project/zephyr-workspace/zephyr/arch/sparc/Kconfig"
osource "D:/SDU/bachelor_project/zephyr-workspace/zephyr/arch/riscv/Kconfig"
osource "D:/SDU/bachelor_project/zephyr-workspace/zephyr/arch/posix/Kconfig"
osource "D:/SDU/bachelor_project/zephyr-workspace/zephyr/arch/mips/Kconfig"
osource "D:/SDU/bachelor_project/zephyr-workspace/zephyr/arch/arm64/Kconfig"
osource "D:/SDU/bachelor_project/zephyr-workspace/zephyr/arch/arm/Kconfig"
osource "D:/SDU/bachelor_project/zephyr-workspace/zephyr/arch/arc/Kconfig"
```

## build/Kconfig/boards/Kconfig
```kconfig
# Load Zephyr board Kconfig descriptions.
osource "D:/SDU/bachelor_project/zephyr-workspace/zephyr/boards/raspberrypi/rpi_pico/Kconfig"
```

## build/Kconfig/boards/Kconfig.defconfig
```kconfig
# Load Zephyr board defconfig descriptions.
osource "D:/SDU/bachelor_project/zephyr-workspace/zephyr/boards/raspberrypi/rpi_pico/Kconfig.defconfig"
```

## build/Kconfig/boards/Kconfig.rpi_pico.tmp
```kconfig
# Load board Kconfig descriptions.
osource "D:/SDU/bachelor_project/zephyr-workspace/zephyr/boards/raspberrypi/rpi_pico/Kconfig.rpi_pico"
```

## build/Kconfig/boards/Kconfig.sysbuild.tmp
```kconfig
# Load Sysbuild board Kconfig descriptions.
osource "D:/SDU/bachelor_project/zephyr-workspace/zephyr/boards/raspberrypi/rpi_pico/Kconfig.sysbuild"
```
