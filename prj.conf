## CMakeLists.txt
```
cmake_minimum_required(VERSION 3.20.0)
find_package(Zephyr REQUIRED HINTS $ENV{ZEPHYR_BASE})
project(iot_protocol)

target_sources(app PRIVATE 
    src/main.c
    src/protocol/communication.c
    src/protocol/IP_connect.c
)

target_include_directories(app PRIVATE Inc)
```

## prj.conf
```kconfig
CONFIG_PRINTK=y
CONFIG_NETWORKING=y
CONFIG_NET_IPV4=y
CONFIG_NET_UDP=y
CONFIG_NET_SOCKETS=y
CONFIG_NET_SOCKETS_POLL_MAX=4
CONFIG_ZVFS_OPEN_MAX=16
CONFIG_WIFI=y
CONFIG_WIFI_AIROC=y
CONFIG_NET_DHCPV4=y
CONFIG_NET_MGMT=y
CONFIG_NET_MGMT_EVENT=y
CONFIG_NET_MGMT_EVENT_INFO=y
CONFIG_TEST_RANDOM_GENERATOR=y

CONFIG_USB_DEVICE_STACK=y
CONFIG_USB_CDC_ACM=y
CONFIG_UART_LINE_CTRL=y
CONFIG_USB_DEVICE_VID=0x2E8A
CONFIG_USB_DEVICE_PID=0x000C

CONFIG_NET_MGMT_EVENT_STACK_SIZE=2048
CONFIG_NET_MGMT_EVENT_QUEUE_SIZE=10
CONFIG_NET_L2_WIFI_MGMT=y
CONFIG_NET_CONNECTION_MANAGER=y
CONFIG_NET_CONNECTION_MANAGER_MONITOR_STACK_SIZE=512
CONFIG_LOG=y
CONFIG_WIFI_LOG_LEVEL_DBG=y
CONFIG_NET_LOG=y
```

## boards/rpi_pico_rp2040_w.overlay
```dts
/ {
    chosen {
        zephyr,console = &cdc_acm_uart0;
    };
};

&zephyr_udc0 {
    cdc_acm_uart0: cdc_acm_uart0 {
        compatible = "zephyr,cdc-acm-uart";
    };
};
```

## src/main.c
```c
#include <zephyr/kernel.h>
#include <zephyr/usb/usb_device.h>
#include <zephyr/net/socket.h>
#include <zephyr/net/wifi_mgmt.h>
#include <zephyr/net/net_mgmt.h>
#include <zephyr/net/net_if.h>

#include <string.h>
#include <errno.h>
#include <stdlib.h>
#include "communication.h"
#include "IP_connect.h"

static uint32_t tx_interval_ms = DEFAULT_TX_INTERVAL_MS;


int main(void)
{
    usb_enable(NULL);
    k_msleep(2000);

    printk("\n=== IoT Client Starting ===\n");

    /* Connect to WiFi first */
    if (wifi_connect() != 0) {
        printk("main: WiFi connection failed, halting\n");
        return -1;
    }

    k_msleep(4000);
    
    init_server_addr();
    while (1)
    {
        send_message();

        printk("main: sleeping for %u ms before next send\n",
            tx_interval_ms);

        k_msleep(tx_interval_ms);
   }
    
    return 0;
}
```

## Inc/IP_connect.h
```c
#ifndef IP_CONNECT_H
#define IP_CONNECT_H

#define WIFI_SSID    "UK-18"
#define WIFI_PSK     "z6r467Mg"

#define SERVER_IP    ""
#define SERVER_PORT  5000

#define ROTATION_INTERVAL 5 /* rotate ports every n sends*/

int wifi_connect(void);
void init_server_addr(void);
int prepare_socket(void);

#endif /* IP_CONNECT_H */
```

## Inc/communication.h
```c
#ifndef COMMUNICATION_H
#define COMMUNICATION_H

#define DEFAULT_TX_INTERVAL_MS 5000
#define MIN_TX_INTERVAL_MS     1000
#define MAX_TX_INTERVAL_MS     60000

void send_message(void);
void receive_ack(void);

#endif /* COMMUNICATION_H */
```

## Inc/ip_header.h
```c
#ifndef IP_HEADER_H
#define IP_HEADER_H

#include <stdint.h>
#include <stddef.h>

/* Simple and lightweight IP header for IoT protocol */
/* Total header size: 20 bytes (IPv4-like but simplified) */

#define IP_HEADER_VERSION 4
#define IP_HEADER_IHL 5          /* Internet Header Length in 32-bit words */
#define IP_HEADER_TOTAL_LEN 20   /* Total header length in bytes */

#define IP_PROTOCOL_TCP 6
#define IP_PROTOCOL_UDP 17
#define IP_PROTOCOL_CUSTOM 99    /* For our IoT protocol */

struct ip_header {
    uint8_t version_ihl;        /* Version (4 bits) + IHL (4 bits) */
    uint8_t tos;               /* Type of Service */
    uint16_t total_length;     /* Total length of IP packet */
    uint16_t identification;   /* Identification for fragmentation */
    uint16_t flags_offset;     /* Flags (3 bits) + Fragment offset (13 bits) */
    uint8_t ttl;              /* Time to Live */
    uint8_t protocol;          /* Protocol (TCP=6, UDP=17, Custom=99) */
    uint16_t checksum;         /* Header checksum */
    uint32_t src_ip;           /* Source IP address */
    uint32_t dst_ip;           /* Destination IP address */
};

/* Helper functions for IP header manipulation */
void ip_header_init(struct ip_header *header, uint32_t src_ip, uint32_t dst_ip, uint8_t protocol);
uint16_t ip_header_checksum(const struct ip_header *header);
void ip_header_set_total_length(struct ip_header *header, uint16_t length);
uint16_t ip_header_get_total_length(const struct ip_header *header);

#endif /* IP_HEADER_H */
```

## Inc/message_format.h
```c
#ifndef MESSAGE_FORMAT_H
#define MESSAGE_FORMAT_H

#include <stdint.h>
#include <stddef.h>

#define MSG_HEADER_LEN 6
#define MSG_TLV_HDR_LEN 2
#define MSG_MAX_PACKET_LEN 64

enum msg_commands {
    MSG_CMD_POST = 0x01,
    MSG_CMD_GET  = 0x02,
    MSG_CMD_ACK  = 0x03,
};

enum msg_result {
    MSG_OK = 0,
    MSG_ERR_INVALID = -1,
    MSG_ERR_NO_SPACE = -2,
};

enum msg_tlv_type {
    MSG_TLV_TEMPERATURE = 0x01, /* int16, value = Celsius * 10 */
    MSG_TLV_HUMIDITY    = 0x02, /* uint16, value = Percent * 10 */
    MSG_TLV_ERROR       = 0x7F,
};

/*
 * Fixed header, 6 bytes on wire:
 * byte 0: device_type
 * byte 1: device_id high byte
 * byte 2: device_id low byte
 * byte 3: protocol_version
 * byte 4: flag
 * byte 5: command
 */
struct msg_header {
    uint8_t device_type;
    uint16_t device_id;
    uint8_t protocol_version;
    uint8_t flag;
    uint8_t command;
};

/*
 * TLV item on wire:
 * byte 0: type
 * byte 1: length
 * byte 2..: value bytes
 */
struct msg_tlv_view {
    uint8_t type;
    uint8_t len;
    const uint8_t *value;
};

struct msg_packet {
    uint8_t *buffer;
    size_t buffer_len;
    size_t offset;
};



/* Function declarations */
int msg_add_tlv(uint8_t *buf,
                size_t buf_len,
                size_t *offset,
                uint8_t type,
                const void *value,
                uint8_t value_len);

int msg_build_header(uint8_t *buf,
                     size_t buf_len,
                     const struct msg_header *header);

int msg_packet_init(struct msg_packet *pkt,
                    uint8_t *buffer,
                    size_t buffer_len,
                    const struct msg_header *header);

int msg_add_tlv_u16(struct msg_packet *pkt,
                    uint8_t type,
                    uint16_t value);                  

#endif
```

## Inc/socket.h
```c
#ifndef SOCKET_H
#define SOCKET_H

void prepare_socket(void);

#endif /* SOCKET_H */
```

## src/ip_header.c
```c
#include "ip_header.h"
#include <stdio.h>
#include <stdlib.h>

/* ==================== Internal Helper Functions ==================== */

/**
 * Validate variable name (alphanumeric and underscores)
 */
static bool ip_is_valid_var_name(const char *name)
{
    if (!name || strlen(name) == 0 || strlen(name) > IP_HEADER_MAX_VAR_NAME)
        return false;

    for (size_t i = 0; i < strlen(name); i++) {
        char c = name[i];
        if (!((c >= 'a' && c <= 'z') || (c >= '0' && c <= '9') || c == '_'))
            return false;
    }
    return true;
}

/**
 * Validate device ID
 */
static bool ip_is_valid_device_id(const char *device_id)
{
    if (!device_id || strlen(device_id) == 0 || strlen(device_id) > IP_HEADER_MAX_VAR_NAME)
        return false;
    return true;
}

/**
 * Escape special characters in values
 */
static void ip_escape_value(const char *src, char *dst, size_t dst_size)
{
    size_t src_idx = 0, dst_idx = 0;
    while (src[src_idx] != '\0' && dst_idx < dst_size - 1) {
        char c = src[src_idx];
        if (c == IP_HEADER_FRAME_DELIM || c == IP_HEADER_VAR_DELIM || 
            c == '#' || c == '@' || c == '^' || c == '{' || c == '}') {
            if (dst_idx < dst_size - 2) {
                dst[dst_idx++] = '\\';
                dst[dst_idx++] = c;
            }
        } else {
            dst[dst_idx++] = c;
        }
        src_idx++;
    }
    dst[dst_idx] = '\0';
}

/**
 * Unescape special characters in values
 */
static void ip_unescape_value(const char *src, char *dst, size_t dst_size)
{
    size_t src_idx = 0, dst_idx = 0;
    while (src[src_idx] != '\0' && dst_idx < dst_size - 1) {
        if (src[src_idx] == '\\' && src[src_idx + 1] != '\0') {
            dst[dst_idx++] = src[src_idx + 1];
            src_idx += 2;
        } else {
            dst[dst_idx++] = src[src_idx++];
        }
    }
    dst[dst_idx] = '\0';
}

/* ==================== Frame Initialization ==================== */

int ip_frame_init(ip_frame_t *frame, const char *device_id)
{
    if (!frame || !ip_is_valid_device_id(device_id))
        return -1;

    frame->version = IP_HEADER_VERSION;
    strncpy(frame->device_id, device_id, IP_HEADER_MAX_VAR_NAME - 1);
    frame->device_id[IP_HEADER_MAX_VAR_NAME - 1] = '\0';
    frame->variable_count = 0;
    frame->sequence_num = 0;
    frame->has_sequence = false;
    frame->created_at = 0; /* Set by application if needed */

    return 0;
}

/* ==================== Variable Management ==================== */

int ip_frame_add_variable(ip_frame_t *frame, const char *name,
                          ip_data_type_t type, const char *value,
                          sensor_type_t sensor_type)
{
    if (!frame || !ip_is_valid_var_name(name) || !value)
        return -1;

    if (frame->variable_count >= IP_HEADER_MAX_VARIABLES)
        return -1;

    if (strlen(value) > IP_HEADER_MAX_VAR_VALUE)
        return -1;

    ip_variable_t *var = &frame->variables[frame->variable_count];

    strncpy(var->name, name, IP_HEADER_MAX_VAR_NAME - 1);
    var->name[IP_HEADER_MAX_VAR_NAME - 1] = '\0';

    var->type = type;

    ip_escape_value(value, var->value, IP_HEADER_MAX_VAR_VALUE);
    
    var->sensor_type = sensor_type;
    var->has_unit = false;
    var->has_timestamp = false;
    var->has_metadata = false;
    var->unit[0] = '\0';
    var->metadata[0] = '\0';
    var->timestamp = 0;

    frame->variable_count++;

    return 0;
}

int ip_variable_set_unit(ip_frame_t *frame, const char *unit)
{
    if (!frame || frame->variable_count == 0 || !unit)
        return -1;

    if (strlen(unit) > IP_HEADER_MAX_UNIT - 1)
        return -1;

    ip_variable_t *var = &frame->variables[frame->variable_count - 1];
    strncpy(var->unit, unit, IP_HEADER_MAX_UNIT - 1);
    var->unit[IP_HEADER_MAX_UNIT - 1] = '\0';
    var->has_unit = true;

    return 0;
}

int ip_variable_set_timestamp(ip_frame_t *frame, uint64_t timestamp_ms)
{
    if (!frame || frame->variable_count == 0)
        return -1;

    ip_variable_t *var = &frame->variables[frame->variable_count - 1];
    var->timestamp = timestamp_ms;
    var->has_timestamp = true;

    return 0;
}

int ip_variable_set_metadata(ip_frame_t *frame, const char *metadata)
{
    if (!frame || frame->variable_count == 0 || !metadata)
        return -1;

    if (strlen(metadata) > IP_HEADER_MAX_VAR_VALUE - 1)
        return -1;

    ip_variable_t *var = &frame->variables[frame->variable_count - 1];
    strncpy(var->metadata, metadata, IP_HEADER_MAX_VAR_VALUE - 1);
    var->metadata[IP_HEADER_MAX_VAR_VALUE - 1] = '\0';
    var->has_metadata = true;

    return 0;
}

void ip_frame_set_sequence(ip_frame_t *frame, uint32_t seq_num)
{
    if (!frame)
        return;

    frame->sequence_num = seq_num;
    frame->has_sequence = true;
}

/* ==================== Frame Encoding ==================== */

int ip_frame_encode_text(const ip_frame_t *frame, char *buffer,
                         size_t buffer_size, bool add_sequence)
{
    if (!frame || !buffer || buffer_size < 10)
        return -1;

    int pos = 0;

    /* Method (always PUSH for now) */
    pos += snprintf(buffer + pos, buffer_size - pos, "PUSH");

    /* Sequence (optional) */
    if (add_sequence && frame->has_sequence) {
        pos += snprintf(buffer + pos, buffer_size - pos, "|!%u", frame->sequence_num);
    }

    /* Device ID */
    pos += snprintf(buffer + pos, buffer_size - pos, "|%s", frame->device_id);

    /* Variable block */
    pos += snprintf(buffer + pos, buffer_size - pos, "|[");

    for (uint16_t i = 0; i < frame->variable_count; i++) {
        const ip_variable_t *var = &frame->variables[i];

        if (pos >= (int)buffer_size - 100)
            return -1; /* Buffer overflow protection */

        if (i > 0)
            pos += snprintf(buffer + pos, buffer_size - pos, ";");

        /* Variable name and operator */
        const char *op = ip_data_type_to_operator(var->type);
        pos += snprintf(buffer + pos, buffer_size - pos, "%s%s%s",
                       var->name, op, var->value);

        /* Unit suffix */
        if (var->has_unit) {
            pos += snprintf(buffer + pos, buffer_size - pos, "#%s", var->unit);
        }

        /* Timestamp suffix */
        if (var->has_timestamp) {
            pos += snprintf(buffer + pos, buffer_size - pos, "@%llu",
                           (unsigned long long)var->timestamp);
        }

        /* Metadata suffix */
        if (var->has_metadata) {
            pos += snprintf(buffer + pos, buffer_size - pos, "{%s}", var->metadata);
        }
    }

    pos += snprintf(buffer + pos, buffer_size - pos, "]");

    if (pos >= (int)buffer_size)
        return -1;

    return pos;
}

int ip_frame_encode_binary(const ip_frame_t *frame, uint8_t *buffer,
                           size_t buffer_size)
{
    if (!frame || !buffer || buffer_size < 10)
        return -1;

    size_t pos = 0;

    /* Version */
    if (pos >= buffer_size)
        return -1;
    buffer[pos++] = frame->version;

    /* Device ID length and data */
    uint8_t device_id_len = strlen(frame->device_id);
    if (pos + 1 + device_id_len >= buffer_size)
        return -1;
    buffer[pos++] = device_id_len;
    memcpy(buffer + pos, frame->device_id, device_id_len);
    pos += device_id_len;

    /* Sequence number (optional) */
    if (frame->has_sequence) {
        if (pos + 4 >= buffer_size)
            return -1;
        buffer[pos++] = 1; /* Has sequence marker */
        buffer[pos++] = (frame->sequence_num >> 24) & 0xFF;
        buffer[pos++] = (frame->sequence_num >> 16) & 0xFF;
        buffer[pos++] = (frame->sequence_num >> 8) & 0xFF;
        buffer[pos++] = frame->sequence_num & 0xFF;
    } else {
        if (pos >= buffer_size)
            return -1;
        buffer[pos++] = 0; /* No sequence marker */
    }

    /* Variable count */
    if (pos >= buffer_size)
        return -1;
    buffer[pos++] = frame->variable_count;

    /* Variables */
    for (uint16_t i = 0; i < frame->variable_count; i++) {
        const ip_variable_t *var = &frame->variables[i];

        if (pos + 20 >= buffer_size) /* Minimum space needed */
            return -1;

        /* Variable type */
        buffer[pos++] = (uint8_t)var->type;

        /* Sensor type */
        buffer[pos++] = (uint8_t)var->sensor_type;

        /* Variable name length and data */
        uint8_t name_len = strlen(var->name);
        buffer[pos++] = name_len;
        if (pos + name_len >= buffer_size)
            return -1;
        memcpy(buffer + pos, var->name, name_len);
        pos += name_len;

        /* Variable value length (16-bit) and data */
        uint16_t value_len = strlen(var->value);
        if (pos + 2 + value_len >= buffer_size)
            return -1;
        buffer[pos++] = (value_len >> 8) & 0xFF;
        buffer[pos++] = value_len & 0xFF;
        memcpy(buffer + pos, var->value, value_len);
        pos += value_len;

        /* Unit (optional) */
        if (var->has_unit) {
            uint8_t unit_len = strlen(var->unit);
            if (pos + 1 + unit_len >= buffer_size)
                return -1;
            buffer[pos++] = unit_len;
            memcpy(buffer + pos, var->unit, unit_len);
            pos += unit_len;
        } else {
            buffer[pos++] = 0;
        }

        /* Timestamp (optional, 8 bytes) */
        if (var->has_timestamp) {
            if (pos + 8 >= buffer_size)
                return -1;
            buffer[pos++] = 1; /* Has timestamp marker */
            buffer[pos++] = (var->timestamp >> 56) & 0xFF;
            buffer[pos++] = (var->timestamp >> 48) & 0xFF;
            buffer[pos++] = (var->timestamp >> 40) & 0xFF;
            buffer[pos++] = (var->timestamp >> 32) & 0xFF;
            buffer[pos++] = (var->timestamp >> 24) & 0xFF;
            buffer[pos++] = (var->timestamp >> 16) & 0xFF;
            buffer[pos++] = (var->timestamp >> 8) & 0xFF;
            buffer[pos++] = var->timestamp & 0xFF;
        } else {
            if (pos >= buffer_size)
                return -1;
            buffer[pos++] = 0;
        }

        /* Metadata (optional) */
        if (var->has_metadata) {
            uint16_t meta_len = strlen(var->metadata);
            if (pos + 2 + meta_len >= buffer_size)
                return -1;
            buffer[pos++] = (meta_len >> 8) & 0xFF;
            buffer[pos++] = meta_len & 0xFF;
            memcpy(buffer + pos, var->metadata, meta_len);
            pos += meta_len;
        } else {
            if (pos + 2 >= buffer_size)
                return -1;
            buffer[pos++] = 0;
            buffer[pos++] = 0;
        }
    }

    return pos;
}

/* ==================== Frame Decoding ==================== */

int ip_frame_decode_text(const char *buffer, size_t buffer_size,
                         ip_frame_t *frame)
{
    if (!buffer || buffer_size == 0 || !frame)
        return -1;

    /* This is a simplified parser. Full implementation would handle
     * all escape sequences and edge cases like TagoTiP */

    char temp_buffer[IP_HEADER_MAX_PAYLOAD];
    strncpy(temp_buffer, buffer, sizeof(temp_buffer) - 1);
    temp_buffer[sizeof(temp_buffer) - 1] = '\0';

    char *saveptr = NULL;
    char *token = strtok_r(temp_buffer, "|", &saveptr);

    if (!token || strcmp(token, "PUSH") != 0)
        return -1;

    /* Check for sequence */
    token = strtok_r(NULL, "|", &saveptr);
    if (token[0] == '!') {
        frame->sequence_num = atoi(token + 1);
        frame->has_sequence = true;
        token = strtok_r(NULL, "|", &saveptr);
    }

    /* Device ID */
    if (!token || !ip_is_valid_device_id(token))
        return -1;

    strncpy(frame->device_id, token, IP_HEADER_MAX_VAR_NAME - 1);
    frame->device_id[IP_HEADER_MAX_VAR_NAME - 1] = '\0';

    /* Variable block */
    token = strtok_r(NULL, "|", &saveptr);
    if (!token || token[0] != '[')
        return -1;

    /* Remove brackets */
    if (token[strlen(token) - 1] != ']')
        return -1;

    token[strlen(token) - 1] = '\0';
    token++; /* Skip '[' */

    /* Parse variables (simplified - full implementation needed) */
    char *var_saveptr = NULL;
    char *var_token = strtok_r(token, ";", &var_saveptr);

    while (var_token && frame->variable_count < IP_HEADER_MAX_VARIABLES) {
        /* Parse individual variable (name:=value#unit@timestamp)
         * This is simplified - full implementation would handle all cases */
        
        char *op_pos = strchr(var_token, ':');
        if (!op_pos)
            op_pos = strchr(var_token, '=');
        if (!op_pos)
            op_pos = strchr(var_token, '?');
        if (!op_pos)
            op_pos = strchr(var_token, '@');

        if (!op_pos)
            return -1;

        char var_name[IP_HEADER_MAX_VAR_NAME];
        strncpy(var_name, var_token, op_pos - var_token);
        var_name[op_pos - var_token] = '\0';

        ip_data_type_t type = (ip_data_type_t)*op_pos;

        /* Simple value extraction (would need more robust parsing) */
        char *value_start = op_pos + 2; /* Skip operator */
        char var_value[IP_HEADER_MAX_VAR_VALUE];
        strncpy(var_value, value_start, sizeof(var_value) - 1);
        var_value[sizeof(var_value) - 1] = '\0';

        if (ip_frame_add_variable(frame, var_name, type, var_value, SENSOR_CUSTOM) != 0)
            return -1;

        var_token = strtok_r(NULL, ";", &var_saveptr);
    }

    return 0;
}

int ip_frame_decode_binary(const uint8_t *buffer, size_t buffer_size,
                           ip_frame_t *frame)
{
    if (!buffer || buffer_size < 5 || !frame)
        return -1;

    size_t pos = 0;

    /* Version */
    frame->version = buffer[pos++];

    /* Device ID */
    uint8_t device_id_len = buffer[pos++];
    if (pos + device_id_len > buffer_size)
        return -1;
    memcpy(frame->device_id, buffer + pos, device_id_len);
    frame->device_id[device_id_len] = '\0';
    pos += device_id_len;

    /* Sequence number */
    if (pos >= buffer_size)
        return -1;
    if (buffer[pos++] == 1) {
        if (pos + 4 > buffer_size)
            return -1;
        frame->sequence_num = ((uint32_t)buffer[pos] << 24) |
                             ((uint32_t)buffer[pos + 1] << 16) |
                             ((uint32_t)buffer[pos + 2] << 8) |
                             (uint32_t)buffer[pos + 3];
        frame->has_sequence = true;
        pos += 4;
    } else {
        frame->has_sequence = false;
    }

    /* Variable count */
    if (pos >= buffer_size)
        return -1;
    frame->variable_count = buffer[pos++];

    /* Variables */
    for (uint16_t i = 0; i < frame->variable_count && i < IP_HEADER_MAX_VARIABLES; i++) {
        if (pos + 5 > buffer_size)
            return -1;

        ip_variable_t *var = &frame->variables[i];

        /* Type and sensor type */
        var->type = (ip_data_type_t)buffer[pos++];
        var->sensor_type = (sensor_type_t)buffer[pos++];

        /* Variable name */
        uint8_t name_len = buffer[pos++];
        if (pos + name_len > buffer_size)
            return -1;
        memcpy(var->name, buffer + pos, name_len);
        var->name[name_len] = '\0';
        pos += name_len;

        /* Variable value */
        if (pos + 2 > buffer_size)
            return -1;
        uint16_t value_len = ((uint16_t)buffer[pos] << 8) | buffer[pos + 1];
        pos += 2;
        if (pos + value_len > buffer_size)
            return -1;
        memcpy(var->value, buffer + pos, value_len);
        var->value[value_len] = '\0';
        pos += value_len;

        /* Unit */
        if (pos >= buffer_size)
            return -1;
        uint8_t unit_len = buffer[pos++];
        if (unit_len > 0) {
            if (pos + unit_len > buffer_size)
                return -1;
            memcpy(var->unit, buffer + pos, unit_len);
            var->unit[unit_len] = '\0';
            var->has_unit = true;
            pos += unit_len;
        } else {
            var->has_unit = false;
            var->unit[0] = '\0';
        }

        /* Timestamp */
        if (pos >= buffer_size)
            return -1;
        if (buffer[pos++] == 1) {
            if (pos + 8 > buffer_size)
                return -1;
            var->timestamp = ((uint64_t)buffer[pos] << 56) |
                            ((uint64_t)buffer[pos + 1] << 48) |
                            ((uint64_t)buffer[pos + 2] << 40) |
                            ((uint64_t)buffer[pos + 3] << 32) |
                            ((uint64_t)buffer[pos + 4] << 24) |
                            ((uint64_t)buffer[pos + 5] << 16) |
                            ((uint64_t)buffer[pos + 6] << 8) |
                            (uint64_t)buffer[pos + 7];
            var->has_timestamp = true;
            pos += 8;
        } else {
            var->has_timestamp = false;
        }

        /* Metadata */
        if (pos + 2 > buffer_size)
            return -1;
        uint16_t meta_len = ((uint16_t)buffer[pos] << 8) | buffer[pos + 1];
        pos += 2;
        if (meta_len > 0) {
            if (pos + meta_len > buffer_size)
                return -1;
            memcpy(var->metadata, buffer + pos, meta_len);
            var->metadata[meta_len] = '\0';
            var->has_metadata = true;
            pos += meta_len;
        } else {
            var->has_metadata = false;
            var->metadata[0] = '\0';
        }
    }

    return 0;
}

/* ==================== Utility Functions ==================== */

void ip_frame_clear_variables(ip_frame_t *frame)
{
    if (!frame)
        return;
    frame->variable_count = 0;
}

uint16_t ip_frame_get_variable_count(const ip_frame_t *frame)
{
    if (!frame)
        return 0;
    return frame->variable_count;
}

const ip_variable_t *ip_frame_get_variable(const ip_frame_t *frame,
                                           uint16_t index)
{
    if (!frame || index >= frame->variable_count)
        return NULL;
    return &frame->variables[index];
}

const char *ip_sensor_type_to_string(sensor_type_t sensor_type)
{
    switch (sensor_type) {
        case SENSOR_TEMPERATURE: return "temperature";
        case SENSOR_HUMIDITY:    return "humidity";
        case SENSOR_PRESSURE:    return "pressure";
        case SENSOR_MOISTURE:    return "moisture";
        case SENSOR_LIGHT:       return "light";
        case SENSOR_CO2:         return "co2";
        case SENSOR_GAS:         return "gas";
        case SENSOR_LEVEL:       return "level";
        case SENSOR_WEIGHT:      return "weight";
        case SENSOR_COUNT:       return "count";
        case SENSOR_STATUS:      return "status";
        case SENSOR_CUSTOM:      return "custom";
        default:                 return "unknown";
    }
}

const char *ip_data_type_to_operator(ip_data_type_t type)
{
    switch (type) {
        case IP_TYPE_NUMBER:   return ":=";
        case IP_TYPE_STRING:   return "=";
        case IP_TYPE_BOOLEAN:  return "?=";
        case IP_TYPE_LOCATION: return "@=";
        default:               return "?";
    }
}
```

## src/ip_header.h
```c
#ifndef IP_HEADER_H
#define IP_HEADER_H

#include <stdint.h>
#include <stdbool.h>
#include <string.h>

/**
 * IP Header Protocol - Flexible IoT Payload Format
 * Inspired by TagoTiP (Transport IoT Protocol)
 * 
 * Designed for grain silo sensors (temperature, humidity, etc.)
 * while remaining flexible for multiple sensor types and data formats.
 */

/* ==================== Constants ==================== */

#define IP_HEADER_VERSION       1
#define IP_HEADER_MAX_VARIABLES 32      /* Max variables per message */
#define IP_HEADER_MAX_VAR_NAME  50      /* Max variable name length */
#define IP_HEADER_MAX_VAR_VALUE 256     /* Max variable value length */
#define IP_HEADER_MAX_UNIT      25      /* Max unit string length */
#define IP_HEADER_MAX_PAYLOAD   512     /* Max total payload size */
#define IP_HEADER_FRAME_DELIM   '|'
#define IP_HEADER_VAR_DELIM     ';'
#define IP_HEADER_BLOCK_OPEN    '['
#define IP_HEADER_BLOCK_CLOSE   ']'

/* ==================== Data Type Definitions ==================== */

/**
 * Data type operators - similar to TagoTiP
 * This allows flexible representation of different sensor values
 */
typedef enum {
    IP_TYPE_NUMBER   = ':',  /* :=  Numeric value (int/float) */
    IP_TYPE_STRING   = '=',  /* =   String value */
    IP_TYPE_BOOLEAN  = '?',  /* ?=  Boolean (true/false) */
    IP_TYPE_LOCATION = '@'   /* @=  Location (lat,lng,alt) */
} ip_data_type_t;

/**
 * Sensor data types - specific to grain silo and other IoT applications
 */
typedef enum {
    SENSOR_TEMPERATURE,
    SENSOR_HUMIDITY,
    SENSOR_PRESSURE,
    SENSOR_MOISTURE,
    SENSOR_LIGHT,
    SENSOR_CO2,
    SENSOR_GAS,
    SENSOR_LEVEL,      /* Grain level in silo */
    SENSOR_WEIGHT,
    SENSOR_COUNT,      /* Generic counter */
    SENSOR_STATUS,     /* Generic status */
    SENSOR_CUSTOM      /* User-defined */
} sensor_type_t;

/* ==================== Structures ==================== */

/**
 * Variable metadata
 * Represents a single data point with all optional suffixes
 */
typedef struct {
    char name[IP_HEADER_MAX_VAR_NAME];      /* Variable name */
    ip_data_type_t type;                     /* Data type operator */
    char value[IP_HEADER_MAX_VAR_VALUE];    /* Variable value */
    char unit[IP_HEADER_MAX_UNIT];          /* Optional: unit suffix (#) */
    uint64_t timestamp;                      /* Optional: timestamp in ms (@) */
    char metadata[IP_HEADER_MAX_VAR_VALUE]; /* Optional: metadata ({}) */
    sensor_type_t sensor_type;               /* Sensor classification */
    bool has_unit;
    bool has_timestamp;
    bool has_metadata;
} ip_variable_t;

/**
 * IP Header frame
 * Represents the complete message frame
 */
typedef struct {
    uint8_t version;                         /* Protocol version */
    char device_id[IP_HEADER_MAX_VAR_NAME]; /* Device identifier */
    ip_variable_t variables[IP_HEADER_MAX_VARIABLES];
    uint16_t variable_count;
    uint32_t sequence_num;                   /* Optional sequence counter */
    bool has_sequence;
    uint64_t created_at;                     /* Frame creation timestamp */
} ip_frame_t;

/* ==================== Function Declarations ==================== */

/**
 * Initialize an IP header frame
 * @param frame Pointer to frame structure
 * @param device_id Device identifier string
 * @return 0 on success, -1 on error
 */
int ip_frame_init(ip_frame_t *frame, const char *device_id);

/**
 * Add a variable to the frame
 * @param frame Pointer to frame structure
 * @param name Variable name
 * @param type Data type operator
 * @param value Variable value
 * @param sensor_type Sensor type classification
 * @return 0 on success, -1 if frame is full or invalid input
 */
int ip_frame_add_variable(ip_frame_t *frame, const char *name, 
                          ip_data_type_t type, const char *value,
                          sensor_type_t sensor_type);

/**
 * Add unit suffix to last added variable
 * @param frame Pointer to frame structure
 * @param unit Unit string (e.g., "C", "%", "hPa")
 * @return 0 on success, -1 if no variables or invalid input
 */
int ip_variable_set_unit(ip_frame_t *frame, const char *unit);

/**
 * Set timestamp for last added variable
 * @param frame Pointer to frame structure
 * @param timestamp_ms Timestamp in milliseconds
 * @return 0 on success, -1 if no variables
 */
int ip_variable_set_timestamp(ip_frame_t *frame, uint64_t timestamp_ms);

/**
 * Set metadata for last added variable
 * @param frame Pointer to frame structure
 * @param metadata Metadata string (key=value format)
 * @return 0 on success, -1 if no variables or metadata too long
 */
int ip_variable_set_metadata(ip_frame_t *frame, const char *metadata);

/**
 * Set sequence counter for the frame
 * @param frame Pointer to frame structure
 * @param seq_num Sequence number
 */
void ip_frame_set_sequence(ip_frame_t *frame, uint32_t seq_num);

/**
 * Encode frame to text representation (similar to TagoTiP)
 * Example: "PUSH|device-01|[temp:=32.5#C;humidity:=65#%]"
 * 
 * @param frame Pointer to frame structure
 * @param buffer Output buffer
 * @param buffer_size Size of output buffer
 * @param add_sequence Whether to include sequence number
 * @return Length of encoded data on success, -1 on error
 */
int ip_frame_encode_text(const ip_frame_t *frame, char *buffer, 
                         size_t buffer_size, bool add_sequence);

/**
 * Encode frame to binary representation
 * Binary format:
 * [version:1][device_id_len:1][device_id:N][var_count:1]
 * [for each variable: type:1|name_len:1|name:N|value_len:2|value:N|...]
 * 
 * @param frame Pointer to frame structure
 * @param buffer Output buffer
 * @param buffer_size Size of output buffer
 * @return Length of encoded data on success, -1 on error
 */
int ip_frame_encode_binary(const ip_frame_t *frame, uint8_t *buffer,
                           size_t buffer_size);

/**
 * Decode text frame (parse TagoTiP-like format)
 * 
 * @param buffer Input buffer with text frame
 * @param buffer_size Size of input buffer
 * @param frame Pointer to frame structure to populate
 * @return 0 on success, -1 on parse error
 */
int ip_frame_decode_text(const char *buffer, size_t buffer_size,
                         ip_frame_t *frame);

/**
 * Decode binary frame
 * 
 * @param buffer Input buffer with binary frame
 * @param buffer_size Size of input buffer
 * @param frame Pointer to frame structure to populate
 * @return 0 on success, -1 on parse error
 */
int ip_frame_decode_binary(const uint8_t *buffer, size_t buffer_size,
                           ip_frame_t *frame);

/**
 * Clear all variables from frame
 * @param frame Pointer to frame structure
 */
void ip_frame_clear_variables(ip_frame_t *frame);

/**
 * Get variable count in frame
 * @param frame Pointer to frame structure
 * @return Number of variables
 */
uint16_t ip_frame_get_variable_count(const ip_frame_t *frame);

/**
 * Get variable by index
 * @param frame Pointer to frame structure
 * @param index Variable index
 * @return Pointer to variable or NULL if index out of bounds
 */
const ip_variable_t *ip_frame_get_variable(const ip_frame_t *frame, 
                                           uint16_t index);

/**
 * Get sensor type name as string
 * @param sensor_type Sensor type
 * @return String representation of sensor type
 */
const char *ip_sensor_type_to_string(sensor_type_t sensor_type);

/**
 * Get data type operator as string
 * @param type Data type
 * @return String representation (":=", "=", "?=", "@=")
 */
const char *ip_data_type_to_operator(ip_data_type_t type);

#endif /* IP_HEADER_H */
```

## src/ip_header_examples.c
```c
/**
 * Example Usage of IP Header Protocol
 * 
 * Grain Silo Sensor Data Example
 * Demonstrates flexible data types for temperature, humidity, and other sensors
 */

#include "ip_header.h"
#include <stdio.h>
#include <time.h>

/**
 * Example 1: Basic grain silo data with temperature and humidity
 */
void example_basic_grain_silo(void)
{
    printf("\n=== Example 1: Basic Grain Silo Data ===\n");

    ip_frame_t frame;
    char buffer[IP_HEADER_MAX_PAYLOAD];

    /* Initialize frame for device "silo-01" */
    if (ip_frame_init(&frame, "silo-01") != 0) {
        printf("ERROR: Failed to initialize frame\n");
        return;
    }

    /* Add temperature reading */
    if (ip_frame_add_variable(&frame, "temperature", IP_TYPE_NUMBER, "28.5",
                              SENSOR_TEMPERATURE) != 0) {
        printf("ERROR: Failed to add temperature\n");
        return;
    }
    ip_variable_set_unit(&frame, "C");
    ip_variable_set_timestamp(&frame, 1694567890000);

    /* Add humidity reading */
    if (ip_frame_add_variable(&frame, "humidity", IP_TYPE_NUMBER, "65.2",
                              SENSOR_HUMIDITY) != 0) {
        printf("ERROR: Failed to add humidity\n");
        return;
    }
    ip_variable_set_unit(&frame, "%");
    ip_variable_set_timestamp(&frame, 1694567890000);

    /* Add grain level */
    if (ip_frame_add_variable(&frame, "grain_level", IP_TYPE_NUMBER, "450",
                              SENSOR_LEVEL) != 0) {
        printf("ERROR: Failed to add grain level\n");
        return;
    }
    ip_variable_set_unit(&frame, "kg");

    /* Encode to text format (human-readable) */
    int encoded_len = ip_frame_encode_text(&frame, buffer, sizeof(buffer), false);
    if (encoded_len > 0) {
        printf("Text Format: %s\n", buffer);
        printf("Encoded length: %d bytes\n\n", encoded_len);
    }

    printf("Variables in frame: %u\n", ip_frame_get_variable_count(&frame));
    for (uint16_t i = 0; i < ip_frame_get_variable_count(&frame); i++) {
        const ip_variable_t *var = ip_frame_get_variable(&frame, i);
        printf("  [%u] %s %s %s", i, var->name, ip_data_type_to_operator(var->type), var->value);
        if (var->has_unit)
            printf("#%s", var->unit);
        if (var->has_timestamp)
            printf("@%llu", (unsigned long long)var->timestamp);
        printf(" (sensor: %s)\n", ip_sensor_type_to_string(var->sensor_type));
    }
}

/**
 * Example 2: Binary encoding (compact format for bandwidth-limited networks)
 */
void example_binary_encoding(void)
{
    printf("\n=== Example 2: Binary Encoding ===\n");

    ip_frame_t frame;
    uint8_t binary_buffer[IP_HEADER_MAX_PAYLOAD];
    char text_buffer[256];

    ip_frame_init(&frame, "silo-02");

    /* Add temperature */
    ip_frame_add_variable(&frame, "temp", IP_TYPE_NUMBER, "32.1", SENSOR_TEMPERATURE);
    ip_variable_set_unit(&frame, "C");

    /* Add pressure */
    ip_frame_add_variable(&frame, "pressure", IP_TYPE_NUMBER, "1013.25", SENSOR_PRESSURE);
    ip_variable_set_unit(&frame, "hPa");

    /* Encode to binary */
    int binary_len = ip_frame_encode_binary(&frame, binary_buffer, sizeof(binary_buffer));
    if (binary_len > 0) {
        printf("Binary encoding length: %d bytes\n", binary_len);
        printf("Binary data (hex): ");
        for (int i = 0; i < binary_len; i++) {
            printf("%02x ", binary_buffer[i]);
        }
        printf("\n\n");

        /* Text encoding for comparison */
        int text_len = ip_frame_encode_text(&frame, text_buffer, sizeof(text_buffer), false);
        if (text_len > 0) {
            printf("Text encoding length: %d bytes\n", text_len);
            printf("Text format: %s\n", text_buffer);
            printf("Compression ratio: %.2f%%\n", (float)binary_len / text_len * 100);
        }
    }
}

/**
 * Example 3: Sequence counter for request/response correlation
 */
void example_sequence_counter(void)
{
    printf("\n=== Example 3: Sequence Counter ===\n");

    ip_frame_t frame;
    char buffer[IP_HEADER_MAX_PAYLOAD];

    ip_frame_init(&frame, "silo-03");

    /* Add sensor data */
    ip_frame_add_variable(&frame, "status", IP_TYPE_STRING, "running", SENSOR_STATUS);
    ip_frame_add_variable(&frame, "error_count", IP_TYPE_NUMBER, "0", SENSOR_COUNT);

    /* Set sequence number for tracking */
    ip_frame_set_sequence(&frame, 42);

    /* Encode with sequence */
    int encoded_len = ip_frame_encode_text(&frame, buffer, sizeof(buffer), true);
    if (encoded_len > 0) {
        printf("With sequence counter:\n");
        printf("  %s\n\n", buffer);
    }

    /* Encode without sequence */
    encoded_len = ip_frame_encode_text(&frame, buffer, sizeof(buffer), false);
    if (encoded_len > 0) {
        printf("Without sequence counter:\n");
        printf("  %s\n", buffer);
    }
}

/**
 * Example 4: Complex metadata and timestamps
 */
void example_advanced_metadata(void)
{
    printf("\n=== Example 4: Advanced Metadata ===\n");

    ip_frame_t frame;
    char buffer[IP_HEADER_MAX_PAYLOAD];

    ip_frame_init(&frame, "silo-04");

    /* Temperature with detailed metadata */
    ip_frame_add_variable(&frame, "temperature", IP_TYPE_NUMBER, "29.8", SENSOR_TEMPERATURE);
    ip_variable_set_unit(&frame, "C");
    ip_variable_set_timestamp(&frame, 1694567890123);
    ip_variable_set_metadata(&frame, "source=DHT22,quality=high,calibrated=true");

    /* Humidity with location */
    ip_frame_add_variable(&frame, "humidity", IP_TYPE_NUMBER, "72.5", SENSOR_HUMIDITY);
    ip_variable_set_unit(&frame, "%");
    ip_variable_set_metadata(&frame, "source=DHT22,quality=medium");

    int encoded_len = ip_frame_encode_text(&frame, buffer, sizeof(buffer), false);
    if (encoded_len > 0) {
        printf("Frame with metadata:\n%s\n", buffer);
    }
}

/**
 * Example 5: Multiple sensor types for different use cases
 */
void example_multiple_sensors(void)
{
    printf("\n=== Example 5: Multiple Sensor Types ===\n");

    ip_frame_t frame;
    char buffer[IP_HEADER_MAX_PAYLOAD];

    ip_frame_init(&frame, "multi-sensor-01");

    /* Grain silo sensors */
    ip_frame_add_variable(&frame, "silo_temp", IP_TYPE_NUMBER, "25.3", SENSOR_TEMPERATURE);
    ip_variable_set_unit(&frame, "C");

    ip_frame_add_variable(&frame, "silo_humidity", IP_TYPE_NUMBER, "68", SENSOR_HUMIDITY);
    ip_variable_set_unit(&frame, "%");

    /* Environmental sensors */
    ip_frame_add_variable(&frame, "ambient_light", IP_TYPE_NUMBER, "450", SENSOR_LIGHT);
    ip_variable_set_unit(&frame, "lux");

    ip_frame_add_variable(&frame, "soil_moisture", IP_TYPE_NUMBER, "45.2", SENSOR_MOISTURE);
    ip_variable_set_unit(&frame, "%");

    /* Air quality */
    ip_frame_add_variable(&frame, "co2_level", IP_TYPE_NUMBER, "412", SENSOR_CO2);
    ip_variable_set_unit(&frame, "ppm");

    /* System status */
    ip_frame_add_variable(&frame, "device_status", IP_TYPE_STRING, "healthy", SENSOR_STATUS);
    ip_frame_add_variable(&frame, "battery", IP_TYPE_NUMBER, "87", SENSOR_COUNT);
    ip_variable_set_unit(&frame, "%");

    int encoded_len = ip_frame_encode_text(&frame, buffer, sizeof(buffer), false);
    if (encoded_len > 0) {
        printf("Multi-sensor frame:\n%s\n\n", buffer);
        printf("Total variables: %u\n", ip_frame_get_variable_count(&frame));
    }
}

/**
 * Example 6: Binary round-trip (encode and decode)
 */
void example_roundtrip(void)
{
    printf("\n=== Example 6: Binary Round-Trip ===\n");

    ip_frame_t frame1, frame2;
    uint8_t binary_buffer[IP_HEADER_MAX_PAYLOAD];

    /* Create original frame */
    ip_frame_init(&frame1, "roundtrip-test");
    ip_frame_add_variable(&frame1, "value1", IP_TYPE_NUMBER, "42.5", SENSOR_TEMPERATURE);
    ip_variable_set_unit(&frame1, "C");
    ip_frame_add_variable(&frame1, "value2", IP_TYPE_STRING, "test_string", SENSOR_STATUS);
    ip_frame_set_sequence(&frame1, 99);

    /* Encode to binary */
    int binary_len = ip_frame_encode_binary(&frame1, binary_buffer, sizeof(binary_buffer));
    printf("Original frame encoded to %d bytes\n", binary_len);

    /* Decode back */
    if (ip_frame_decode_binary(binary_buffer, binary_len, &frame2) == 0) {
        printf("Successfully decoded frame\n");
        printf("  Device ID: %s\n", frame2.device_id);
        printf("  Variables: %u\n", ip_frame_get_variable_count(&frame2));
        printf("  Sequence: %u (has_seq: %s)\n", frame2.sequence_num,
               frame2.has_sequence ? "yes" : "no");

        for (uint16_t i = 0; i < ip_frame_get_variable_count(&frame2); i++) {
            const ip_variable_t *var = ip_frame_get_variable(&frame2, i);
            printf("    [%u] %s %s %s", i, var->name, 
                   ip_data_type_to_operator(var->type), var->value);
            if (var->has_unit)
                printf("#%s", var->unit);
            printf("\n");
        }
    } else {
        printf("ERROR: Failed to decode binary frame\n");
    }
}

int main(void)
{
    printf("IP Header Protocol - Usage Examples\n");
    printf("===================================\n");

    example_basic_grain_silo();
    example_binary_encoding();
    example_sequence_counter();
    example_advanced_metadata();
    example_multiple_sensors();
    example_roundtrip();

    printf("\n=== Examples Complete ===\n");

    return 0;
}
```
